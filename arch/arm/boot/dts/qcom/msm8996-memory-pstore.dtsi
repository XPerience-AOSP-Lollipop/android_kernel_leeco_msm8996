/*
   Pstore feature is used to replace last_kmsg feature since kernel 3.10.
*/

&soc {
	ramoops {
		compatible = "ramoops";
		status = "ok";

		android,ramoops-buffer-start = <0x1f600000>;
		android,ramoops-buffer-size = <0x200000>;
		android,ramoops-console-size = <0x100000>;
		android,ramoops-record-size = <0x10000>;
		android,ramoops-ftrace-size = <0x10000>;
		android,ramoops-pmsg-size = <0x80000>;
		android,ramoops-dump-oops = <0x1>;
	};
};
